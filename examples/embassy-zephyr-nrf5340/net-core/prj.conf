## CMakeLists.txt
```
cmake_minimum_required(VERSION 3.20.0)

include(FetchContent)

# App core vars
set(APP_CORE_MANIFEST_PATH ../app-core/Cargo.toml)
set(APP_CORE_HEX_NAME app-core.hex)

# Build the net core
set(BOARD nrf5340dk/nrf5340/cpunet)
set(CMAKE_EXPORT_COMPILE_COMMANDS 1)
set_property(GLOBAL APPEND PROPERTY HEX_FILES_TO_MERGE ../${APP_CORE_HEX_NAME} zephyr.hex)

find_package(Zephyr REQUIRED HINTS $ENV{ZEPHYR_BASE})
project(ipc_service_remote)

target_sources(app PRIVATE src/main.c)


# Build the app core
FetchContent_Declare(
    Corrosion
    GIT_REPOSITORY https://github.com/corrosion-rs/corrosion.git
    GIT_TAG v0.5
)
set(Rust_CARGO_TARGET thumbv8m.main-none-eabihf)
FetchContent_MakeAvailable(Corrosion)

corrosion_import_crate(
    MANIFEST_PATH ${APP_CORE_MANIFEST_PATH}
    NO_STD
    NO_LINKER_OVERRIDE
    LOCKED
    PROFILE release
)
add_custom_command(
    OUTPUT ${APP_CORE_HEX_NAME}
    COMMAND cp $<TARGET_PROPERTY:app-core,IMPORTED_LOCATION> $<TARGET_PROPERTY:app-core,IMPORTED_LOCATION>.elf
    COMMAND $<TARGET_PROPERTY:bintools,elfconvert_command>
            $<TARGET_PROPERTY:bintools,elfconvert_flag>
            $<TARGET_PROPERTY:bintools,elfconvert_flag_outtarget>ihex
            $<TARGET_PROPERTY:bintools,elfconvert_flag_infile>$<TARGET_PROPERTY:app-core,IMPORTED_LOCATION>
            $<TARGET_PROPERTY:bintools,elfconvert_flag_outfile>${APP_CORE_HEX_NAME}
            $<TARGET_PROPERTY:bintools,elfconvert_flag_final>
    COMMENT "Generating ${APP_CORE_HEX_NAME}"
    DEPENDS $<TARGET_PROPERTY:app-core,IMPORTED_LOCATION>
)
add_custom_target(app-core-hex DEPENDS ${APP_CORE_HEX_NAME})
```

## west.yml
```
# Copyright (c) 2021 Nordic Semiconductor ASA
# SPDX-License-Identifier: Apache-2.0

manifest:

  remotes:
    - name: zephyrproject-rtos
      url-base: https://github.com/zephyrproject-rtos

  projects:
    - name: zephyr
      remote: zephyrproject-rtos
      revision: v4.2.0
      import:
        # By using name-allowlist we can clone only the modules that are
        # strictly needed by the application.
        name-allowlist:
          - cmsis_6    # required by the ARM port for Cortex-M
          - hal_nordic # required by the custom_plank board (Nordic based)
          - segger     # segger rtt
```

## prj.conf
```kconfig
CONFIG_PRINTK=y
CONFIG_USE_SEGGER_RTT=y
CONFIG_SEGGER_RTT_BUFFER_SIZE_UP=4096

CONFIG_CLOCK_CONTROL_NRF_K32SRC_RC=y
CONFIG_CLOCK_CONTROL_NRF_K32SRC_50PPM=y

CONFIG_IPC_SERVICE=y
CONFIG_IPC_SERVICE_BACKEND_ICMSG=y
CONFIG_MBOX=y

CONFIG_LOG=y
CONFIG_ASSERT=y
```

## src/main.c
```c
/*
 * Copyright (c) 2022 Nordic Semiconductor ASA
 *
 * SPDX-License-Identifier: Apache-2.0
 */

#include <zephyr/kernel.h>
#include <zephyr/device.h>

#include <zephyr/ipc/ipc_service.h>

#include <zephyr/logging/log.h>
LOG_MODULE_REGISTER(remote, LOG_LEVEL_INF);


K_SEM_DEFINE(bound_sem, 0, 1);

static void ep_bound(void *priv)
{
    k_sem_give(&bound_sem);
    LOG_INF("Ep bounded");
}

static void ep_recv(const void *data, size_t len, void *priv)
{
    LOG_HEXDUMP_INF(data, len, "Received");
}

static int send_for_time(struct ipc_ept *ep, const int64_t sending_time_ms)
{
    char msg[8] = {0};
    size_t bytes_sent = 0;
    int msg_idx = 0;
    char next_byte = 0;
    int ret = 0;

    LOG_INF("Perform sends for %lld [ms]", sending_time_ms);

    int64_t start = k_uptime_get();

    while ((k_uptime_get() - start) < sending_time_ms) {
        ret = ipc_service_send(ep, msg, sizeof(msg));
        if (ret == -ENOMEM) {
            /* No space in the buffer. Retry. */
            continue;
        } else if (ret < 0) {
            LOG_ERR("Failed to send with ret %d", ret);
            break;
        }
        LOG_HEXDUMP_INF(msg, sizeof(msg), "Sent");

        msg[msg_idx] = ++next_byte;
        msg_idx++;
        if (msg_idx == sizeof(msg)) {
            msg_idx = 0;
        }

        bytes_sent += sizeof(msg);

        k_usleep(1000000);
    }

    LOG_INF("Sent %zu [Bytes] over %lld [ms]", bytes_sent, sending_time_ms);

    return ret;
}

static struct ipc_ept_cfg ep_cfg = {
    .cb = {
        .bound    = ep_bound,
        .received = ep_recv,
    },
};

int main(void)
{
    const struct device *ipc0_instance;
    struct ipc_ept ep;
    int ret;

    LOG_INF("IPC-service REMOTE demo started");

    ipc0_instance = DEVICE_DT_GET(DT_NODELABEL(ipc0));

    ret = ipc_service_open_instance(ipc0_instance);
    if ((ret < 0) && (ret != -EALREADY)) {
        LOG_ERR("ipc_service_open_instance() failure");
        return ret;
    }

    ret = ipc_service_register_endpoint(ipc0_instance, &ep, &ep_cfg);
    if (ret != 0) {
        LOG_ERR("ipc_service_register_endpoint() failure");
        return ret;
    }

    k_sem_take(&bound_sem, K_FOREVER);

    ret = send_for_time(&ep, 10000);
    if (ret < 0) {
        LOG_ERR("send_for_time() failure");
        return ret;
    }

    LOG_INF("IPC-service REMOTE demo ended");

    return 0;
}
```
